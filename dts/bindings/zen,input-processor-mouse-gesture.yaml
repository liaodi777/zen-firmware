## dts/bindings/zen,input-processor-mouse-gesture.yaml
```yaml
description: Four-direction mouse gesture input processor

compatible: "zen,input-processor-mouse-gesture"

properties:
  "#input-processor-cells":
    type: int
    const: 0

  layer:
    type: int
    required: true

  threshold:
    type: int
    required: true

  bindings:
    type: phandle-array
    required: true
```
